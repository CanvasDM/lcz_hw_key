## CMakeLists.txt
```
#
# Copyright (c) 2022 Laird Connectivity
#
# SPDX-License-Identifier: LicenseRef-LairdConnectivity-Clause
#

# Building TFM requires Cmake 3.15.
cmake_minimum_required(VERSION 3.15)

find_package(Zephyr REQUIRED HINTS $ENV{ZEPHYR_BASE})

project(lcz_hw_key)

target_sources(app PRIVATE src/main.c)
```

## prj.conf
```kconfig
#
# Copyright (c) 2022 Laird Connectivity
#
# SPDX-License-Identifier: LicenseRef-LairdConnectivity-Clause
#
CONFIG_LOG=y
CONFIG_LCZ_HW_KEY=y
CONFIG_PM_SINGLE_IMAGE=y
CONFIG_MPU_ALLOW_FLASH_WRITE=y
CONFIG_RESET_ON_FATAL_ERROR=n
CONFIG_NRF_SECURITY=y

CONFIG_SECURE_BOOT=y
CONFIG_BOOTLOADER_MCUBOOT=y
CONFIG_REBOOT=y
CONFIG_MBEDTLS_PSA_CRYPTO_C=y
CONFIG_MAIN_STACK_SIZE=4096
CONFIG_MBEDTLS_ENABLE_HEAP=y
CONFIG_HW_UNIQUE_KEY=y
CONFIG_HW_UNIQUE_KEY_RANDOM=y
```

## boards/bl5340_dvk_cpuapp.conf
```kconfig
#
# Copyright (c) 2022 Laird Connectivity
#
# SPDX-License-Identifier: LicenseRef-LairdConnectivity-Clause
#

CONFIG_MBEDTLS_PSA_CRYPTO_C=y
CONFIG_MAIN_STACK_SIZE=4096
CONFIG_MBEDTLS_ENABLE_HEAP=y
CONFIG_HW_UNIQUE_KEY=y
CONFIG_HW_UNIQUE_KEY_RANDOM=y
```

## boards/pinnacle_100_dvk.conf
```kconfig
#
# Copyright (c) 2022 Laird Connectivity
#
# SPDX-License-Identifier: LicenseRef-LairdConnectivity-Clause
#

CONFIG_SECURE_BOOT=y
CONFIG_BOOTLOADER_MCUBOOT=y
CONFIG_REBOOT=y
CONFIG_MBEDTLS_PSA_CRYPTO_C=y
CONFIG_MAIN_STACK_SIZE=4096
CONFIG_MBEDTLS_ENABLE_HEAP=y
CONFIG_HW_UNIQUE_KEY=y
CONFIG_HW_UNIQUE_KEY_RANDOM=y
```

## src/main.c
```c
/*
 * Copyright (c) 2022 Laird Connectivity LLC
 *
 * SPDX-License-Identifier: LicenseRef-LairdConnectivity-Clause
 */

#include <logging/log.h>
LOG_MODULE_REGISTER(main, LOG_LEVEL_DBG);

#include <zephyr.h>

#include "lcz_hw_key.h"

#define PLAIN_TEXT_MAX_SIZE (100)
#define AUTH_DATA "My AUTH data"

static uint8_t plain_text[PLAIN_TEXT_MAX_SIZE] = {
	"This is an example string that will be encrypted and decrypted."
};
static uint8_t encrypted_text[PLAIN_TEXT_MAX_SIZE + LCZ_HW_KEY_MAC_LEN];
static uint8_t decrypted_text[PLAIN_TEXT_MAX_SIZE];

void main(void)
{
	uint32_t encrypted_data_size;
	uint32_t decrypted_data_size;
	uint8_t iv[LCZ_HW_KEY_IV_LEN];

	lcz_hw_key_generate_iv(iv, LCZ_HW_KEY_IV_LEN);

	lcz_hw_key_encrypt_data((const uint8_t *)iv, LCZ_HW_KEY_IV_LEN, AUTH_DATA,
				sizeof(AUTH_DATA), (const uint8_t *)plain_text, strlen(plain_text),
				encrypted_text, sizeof(encrypted_text), &encrypted_data_size);

	LOG_HEXDUMP_INF(encrypted_text, encrypted_data_size, "Encrypted data:");

	lcz_hw_key_decrypt_data((const uint8_t *)iv, LCZ_HW_KEY_IV_LEN, AUTH_DATA,
				sizeof(AUTH_DATA), (const uint8_t *)encrypted_text,
				encrypted_data_size, decrypted_text, sizeof(decrypted_text),
				&decrypted_data_size);

	LOG_INF("Decrypted data: %s", decrypted_text);
}
```

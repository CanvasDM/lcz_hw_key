## Kconfig
```kconfig
#
# Copyright (c) 2022 Laird Connectivity LLC
#
# SPDX-License-Identifier: LicenseRef-LairdConnectivity-Clause
#
menuconfig LCZ_HW_KEY
    bool "LC HW Key API"
    depends on NRF_SECURITY
    depends on HW_UNIQUE_KEY
    depends on HW_UNIQUE_KEY_RANDOM
    depends on MPU_ALLOW_FLASH_WRITE
    depends on MBEDTLS_ENABLE_HEAP
    depends on MBEDTLS_PSA_CRYPTO_C

if LCZ_HW_KEY

module=LCZ_HW_KEY
module-dep=LOG
module-str=Log level
source "${ZEPHYR_BASE}/subsys/logging/Kconfig.template.log_config"

config LCZ_HW_KEY_INIT_PRIORITY
    int "HW Key Init Priority (APPLICATION)"
    range 0 99
    default 1

config LCZ_HW_KEY_REBOOT_DELAY_SECONDS
    int "Reboot delay"
    default 5

endif # LCZ_HW_KEY
```

## tests/testcase.yaml
```yaml
sample:
  description: Generate random HUK and encrypt and decrypt data using the HUK derived key
  name: LCZ HUK
common:
    tags: lcz_hw_key
    platform_allow: pinnacle_100_dvk bl5340_dvk_cpuapp bt610 mg100
    integration_platforms:
      - pinnacle_100_dvk
      - bl5340_dvk_cpuapp
      - bt610
      - mg100
    harness: console
    harness_config:
      type: multi_line
      regex:
        - "Decrypted data: This is an example string that will be encrypted and decrypted."
tests:
  lcz.hw_key:
    tags: lcz_hw_key ci_build
```
